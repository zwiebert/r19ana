## components/app_config/Kconfig.projbuild
```kconfig
menu "RV Project Configuration"

   config APP_USE_HTTP_SERVE_JS_MAP
        depends on APP_USE_HTTP
        bool "Serve wapp.js.map file"
        default y

    config APP_USE_HTTP_SERVE_CSS_MAP
        depends on APP_USE_HTTP
        bool "Serve wapp.css.map file"
        default n

    config APP_USE_SERIAL
        bool "Activate SERIAL"
        default y

    config APP_USE_WDG
        bool "Activate WDG"
        default y

    config APP_USE_FS
        bool "Activate FS"
        default y

    config APP_USE_HTTP_CLIENT
        bool "Activate HTTP_CLIENT"
        default y

    config APP_USE_CLI_MUTEX
        bool "Activate CLI_MUTEX"
        default y

        
    config APP_USE_HTTP
        depends on APP_USE_NETWORK
        bool "Compile HTTP server"
        default y

    config APP_USE_WS
        depends on APP_USE_HTTP
        bool "Compile with Websocket support"
        default y

    config APP_USE_MQTT
        depends on APP_USE_NETWORK
        bool "Compile MQTT client"
        default y


    config APP_USE_OTA
        depends on APP_USE_NETWORK
        bool "Compile with over-the-air update support"
        default y

    config APP_USE_POSIX_TIME
        bool "Compile with Posix time support"
        default y

    config APP_USE_MUTEX
        bool "Compile with MUTEX support"
        default y
        help
            If disabled, use a dummy instead of a real Mutex
            Note: Disable it only for testing/debugging purposes

    config APP_USE_GPIO_PINS
        bool "Compile with support for user defined GPIOs"
        default y
        help
            The user can define GPIOs from CLI/web-app, which then can be read or set via MQTT

    config APP_USE_FREERTOS
        bool "Compile FreeRTOS-dependent code in common modules"
        default y

    config APP_USE_LPH
        bool "Compile support for liter-per-hour"
        default y


    config APP_USE_EG
        bool "use EG?"
        default y

    config APP_GEO_TZ
        string "POSIX TZ string"
        default "CET-1CEST-2,M3.5.0,M10.5.0"

    config APP_SETTINGS_PASSWORD
        string "password for MCU settings"
        default ""

    config APP_WIFI_AP_SSID
        string "WIFI/WLAN access-point SSID"
        default "rv"

    config APP_WIFI_AP_PASSWORD
        string "WIFI/WLAN access-point password"
        default "12345678"

    config APP_GPIO_NUMBER_OF_GPIOS
        int "Number of available GPIOs"
        default 40
        help
            Number of GPIOs this MCU has (ESP32: 40)

    config MAIN_LOOP_PERIOD_MS
        int "main loop period in milliseconds"
        default 100
        help
            How frequently the main loop is called by timer

    config NETWORK_CHECK_LOOP_PERIOD_S
        int "network check loop period in seconds"
        default 15
        help
            How frequently the network connection is checked for appearing while disconnected

    config APP_USE_PROTOBUF
        bool "Compile Protobuf support"
        default n


endmenu
```

## configs/esp32-release/sdkconfig.defaults
```kconfig
# Override some defaults so BT stack is enabled
CONFIG_BT_ENABLED=y
CONFIG_BTDM_CTRL_MODE_BLE_ONLY=n
CONFIG_BTDM_CTRL_MODE_BR_EDR_ONLY=y
CONFIG_BTDM_CTRL_MODE_BTDM=n
CONFIG_BT_CLASSIC_ENABLED=y
CONFIG_BT_SPP_ENABLED=y
CONFIG_BT_BLE_ENABLED=n
CONFIG_FATFS_VFS_FSTAT_BLKSIZE=4096
#misc
CONFIG_ESPTOOLPY_FLASHSIZE="4MB"
CONFIG_ESPTOOLPY_FLASHSIZE_4MB=y
CONFIG_PARTITION_TABLE_CUSTOM=y
CONFIG_PARTITION_TABLE_CUSTOM_FILENAME="configs/esp32-release/partitions.csv"
CONFIG_PARTITION_TABLE_FILENAME="configs/esp32-release/partitions.csv"
CONFIG_COMPILER_OPTIMIZATION_PERF=y
```

## main/Kconfig.projbuild
```kconfig
menu "SPP Example Configuration"
    config EXAMPLE_SSP_ENABLED
        bool "Secure Simple Pairing"
        depends on BT_CLASSIC_ENABLED
        default y
        help
            This enables the Secure Simple Pairing. If disable this option,
            Bluedroid will only support Legacy Pairing

    config EXAMPLE_LOCAL_DEVICE_NAME
        string "Local Device Name"
        default "R19/XR25 SPP Example"
         depends on BT_CLASSIC_ENABLED
        help
            Use this option to set local device name.

    config EXAMPLE_UART_PORT_NUM
        int "UART port number"
        range 0 2 if IDF_TARGET_ESP32 || IDF_TARGET_ESP32S3
        default 2 if IDF_TARGET_ESP32 || IDF_TARGET_ESP32S3
        range 0 1
        default 1
        help
            UART communication port number for the example.
            See UART documentation for available port numbers.

    config EXAMPLE_UART_BAUD_RATE
        int "UART communication speed"
        range 1200 115200
        default 115200
        help
            UART communication speed for Modbus example.

    config EXAMPLE_UART_RXD
        int "UART RXD pin number"
        default 5
        help
            GPIO number for UART RX pin. See UART documentation for more information
            about available pin numbers for UART.

    config EXAMPLE_UART_TXD
        int "UART TXD pin number"
        default 4
        help
            GPIO number for UART TX pin. See UART documentation for more information
            about available pin numbers for UART.

    config EXAMPLE_TASK_STACK_SIZE
        int "UART echo example task stack size"
        range 1024 16384
        default 3072
        help
            Defines stack size for UART echo example. Insufficient stack size can cause crash.
endmenu
```
